## main/Kconfig.projbuild
```kconfig
menu "MQTT Configuration"

    config APP_MQTT_BROKER_URI
        string "Broker URI"
        default "mqtt://broker.emqx.io:1883"
        help
            Include the scheme: mqtt:// or mqtts://.

    config APP_MQTT_USERNAME
        string "Username"
        default ""

    config APP_MQTT_PASSWORD
        string "Password"
        default ""

    config APP_MQTT_CLIENT_ID_PREFIX
        string "Client ID prefix"
        default "tempnode"
        help
            The MAC address is appended at runtime so each device is unique.

    config APP_MQTT_TOPIC_PREFIX
        string "Topic prefix"
        default "tempnode/CHANGE-ME"

    config APP_MQTT_PUBLISH_INTERVAL_S
        int "Publish interval (seconds)"
        range 2 3600
        default 10

    config APP_MQTT_QOS
        int "Publish QoS"
        range 0 2
        default 0

    config APP_MQTT_RETAIN
        bool "Publish with retain flag"
        default y

    

endmenu
```
